## boards/shields /ergosplitlow_17/Kconfig.shield
```kconfig
config SHIELD_ERGOSPLITLOW_17_LEFT
    def_bool $(shields_list_contains,ergosplitlow_17_left)
config SHIELD_ERGOSPLITLOW_17_RIGHT
    def_bool $(shields_list_contains,ergosplitlow_17_right)
```

## boards/shields/ergosplitlow_17/Kconfig.defconfig
```kconfig
if SHIELD_ERGOSPLITLOW_17_RIGHT

config ZMK_KEYBOARD_NAME
    default "ergosplitlow_17"

endif

if SHIELD_ERGOSPLITLOW_17_LEFT || SHIELD_ERGOSPLITLOW_17_RIGHT

config ZMK_SPLIT
    default y

endif
```
